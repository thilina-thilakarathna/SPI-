;
; spimasterassembly.asm
;
; Created: 07/02/2018 17:26:15
; Author : thilina-pc
;

.INCLUDE "M32DEF.INC"

.EQU    SS          = PORTB4
.EQU     MOSI       = PORTB5
.EQU     MISO         = PORTB6
.EQU     SCK         = PORTB7
.EQU    fclk                = 16000000 
.ORG 0x00
		JMP MAIN

MAIN:
	LDI R16,LOW(RAMEND)
	OUT SPL,R16
	LDI R16,HIGH(RAMEND)
	OUT SPH,R16
	LDI R16,0xFF
	OUT DDRD,R16
	OUT DDRC,R16
	LDI R16,0xB0

	OUT DDRB,R16
	LDI R16,0x51
	OUT SPCR,R16

	LDI R16,'a'
	OUT PORTC,R16
	OUT SPDR,R16

	LOOP:
	IN R17,SPDR
	IN R18,SPSR
	ANDI R16,0b10000000
	LDI     R16, 100                      
    CALL   DELAY_1MS
	CPI R18,0x00
	BREQ LOOP

	LDI R16,'F'
	OUT PORTC,R16
	OUT SPDR,R16

	LOOP1:
	IN R17,SPDR
	IN R16,SPSR
	ANDI R16,0b10000000
	LDI     R18, 100                      
    //CALL    DELAY_1MS
	CPI R16,0x00
	BREQ LOOP1

HERE:
	LDI R18,0xFF
		RJMP    HERE




//==================DELAYS==================================//
//******************CALL A DELAY OF R16*1us*****************//
DELAY_1US:
	CALL DELAYUS
	DEC R16
	BRNE DELAY_1US
DELAYUS:
	PUSH R16
	POP R16
	PUSH R16
	POP R16
	RET


//******************CALL A DELAY OF R16*1ms*****************//
DELAY_1MS:
	CALL DELAYMS
	DEC R16
	BRNE DELAY_1MS

DELAYMS:
	PUSH YL
	PUSH YH
	LDI YH,LOW(((fcLk/1000)-18)/4)
	LDI Yh,HIGH(((fcLk/1000)-18)/4)

DELAY1MS_01:
	SBIW YH:YL,1
	BRNE DELAY1MS_01
	POP YH
	POP YL
	RET
	 
